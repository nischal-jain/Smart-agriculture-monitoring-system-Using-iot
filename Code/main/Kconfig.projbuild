## Code/main/Kconfig.projbuild
```kconfig
menu "wifi Configuration"

config ESP_WIFI_SSID
    string "WiFi SSID"

config ESP_WIFI_PASSWORD
    string "WiFi Password"

config ESP_MAXIMUM_RETRY
    int "Maximum retry"
    default 5

endmenu
```
